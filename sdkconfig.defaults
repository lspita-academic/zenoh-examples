## sdkconfig.defaults
```kconfig
CONFIG_ESP_SYSTEM_PANIC_PRINT_HALT=y
CONFIG_ESP_MAIN_TASK_STACK_SIZE=8192
# Enable multicasting
CONFIG_LWIP_ICMP=y
CONFIG_LWIP_IGMP=y
CONFIG_LWIP_MULTICAST_PING=y
```
